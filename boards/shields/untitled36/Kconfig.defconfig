## boards/shields/untitled36/Kconfig.defconfig
```kconfig
if SHIELD_UNTITLED36_L

config ZMK_KEYBOARD_NAME
    default "Untitled36"

config ZMK_SPLIT
    default y

config ZMK_SPLIT_ROLE_CENTRAL
    default y

endif

if SHIELD_UNTITLED36_R

config ZMK_KEYBOARD_NAME
    default "Untitled36_R"

config ZMK_SPLIT
    default y

endif
```

## boards/shields/untitled36/Kconfig.shield
```kconfig
config SHIELD_UNTITLED36_L
    def_bool $(shields_list_contains,untitled36_l)

config SHIELD_UNTITLED36_R
    def_bool $(shields_list_contains,untitled36_r)
```

## config/west.yml
```yaml
manifest:
  remotes:
    - name: zmkfirmware
      url-base: https://github.com/zmkfirmware
    - name: sekigon-gonnoc
      url-base: https://github.com/sekigon-gonnoc
    - name: urob
      url-base: https://github.com/urob
    - name: caksoylar
      url-base: https://github.com/caksoylar
  projects:
    - name: zmk
      remote: zmkfirmware
      revision: v0.3-branch
      import: app/west.yml
    - name: zmk-driver-paw3222
      remote: sekigon-gonnoc
      revision: main
    - name: zmk-helpers
      remote: urob
      revision: main
    - name: zmk-rgbled-widget
      remote: caksoylar
      revision: v0.3
  self:
    path: config
```
