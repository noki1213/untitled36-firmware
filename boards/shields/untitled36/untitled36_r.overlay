#include "untitled36.dtsi"

&default_transform {
    col-offset = <5>;
};

&kscan0 {
    col-gpios
        = <&xiao_d 0 GPIO_ACTIVE_HIGH>    /* COL0 = D0 = P0.02（小指） */
        , <&xiao_d 4 GPIO_ACTIVE_HIGH>    /* COL1 = D4 = P0.04（薬指） */
        , <&xiao_d 5 GPIO_ACTIVE_HIGH>    /* COL2 = D5 = P0.05（中指） */
        , <&gpio0 9 GPIO_ACTIVE_HIGH>     /* COL3 = P0.09（NFC1・人差し指） */
        , <&gpio0 10 GPIO_ACTIVE_HIGH>    /* COL4 = P0.10（NFC2・内側） */
        ;
};
